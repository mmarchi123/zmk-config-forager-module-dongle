## boards/shields/forager/Kconfig.defconfig
```kconfig
if SHIELD_FORAGER_DONGLE

config ZMK_KEYBOARD_NAME
    default "Forager"

config ZMK_SPLIT_ROLE_CENTRAL
    default y

config ZMK_SPLIT_BLE_CENTRAL_PERIPHERALS
    default 2

endif


if SHIELD_FORAGER_LEFT || SHIELD_FORAGER_RIGHT

config ZMK_IDLE_TIMEOUT	
    default 30000
config ZMK_SLEEP
    default y
config ZMK_IDLE_SLEEP_TIMEOUT 
    default 900000
endif

if SHIELD_FORAGER_DONGLE || SHIELD_FORAGER_LEFT || SHIELD_FORAGER_RIGHT

config ZMK_SPLIT
    default y
endif
```

## config/west.yml
```yaml
manifest:
  remotes:
    - name: zmkfirmware
      url-base: https://github.com/zmkfirmware
    - name: caksoylar
      url-base: https://github.com/caksoylar
    - name: bwshockley
      url-base: https://github.com/bwshockley
  projects:
    - name: zmk
      remote: zmkfirmware
      revision: main
      import: app/west.yml
    - name: zmk-rgbled-widget
      remote: caksoylar
      revision: main
    - name: zmk-dongle-screen
      remote: bwshockley
      revision: main
  self:
    path: config
```
